//------------------------------------------------------------------------------
// This is Open source software. You can place this code on your site, but don't
// forget a link to my YouTube-channel: https://www.youtube.com/channel/UChButpZaL5kUUl_zTyIDFkQ
// РЃС‚Рѕ РїСЂРѕРіСЂР°РјРјРЅРѕРµ РѕР±РµСЃРїРµС‡РµРЅРёРµ СЂР°СЃРїСЂРѕСЃС‚СЂР°РЅв‚¬РµС‚СЃв‚¬ СЃРІРѕР±РѕРґРЅРѕ. В¬С‹ РјРѕР¶РµС‚Рµ СЂР°Р·РјРµС‰Р°С‚СЊ
// РµРіРѕ РЅР° РІР°С€РµРј СЃР°Р№С‚Рµ, РЅРѕ РЅРµ Р·Р°Р±СѓРґСЊС‚Рµ СѓРєР°Р·Р°С‚СЊ СЃСЃС‹Р»РєСѓ РЅР° РјРѕР№ YouTube-РєР°РЅР°Р»
// "РЃР»РµРєС‚СЂРѕРЅРёРєР° РІ РѕР±СЉРµРєС‚РёРєРµ" https://www.youtube.com/channel/UChButpZaL5kUUl_zTyIDFkQ
// С�РІС‚РѕСЂ: РЊР°РґС‹СЂС€РёРЅ вЂ“СѓСЃР»Р°РЅ / Nadyrshin Ruslan
//------------------------------------------------------------------------------
#include <stm32f10x_gpio.h>
#include <stm32f10x_rcc.h>
#include <delay.h>
#include <ssd1306.h>
#include <gpio.h>
//#include <i2cm.h>
#include <spim.h>
#include <stdio.h>
#include <stdlib.h>
#include <stdarg.h>
#include <string.h>


#define SSD1306_RESET_HIGH()    GPIO_WriteBit(SSD1306_Reset_Port, SSD1306_Reset_Pin, Bit_SET)
#define SSD1306_RESET_LOW()     GPIO_WriteBit(SSD1306_Reset_Port, SSD1306_Reset_Pin, Bit_RESET)
#define SSD1306_DC_HIGH()       GPIO_WriteBit(SSD1306_DC_Port, SSD1306_DC_Pin, Bit_SET)
#define SSD1306_DC_LOW()        GPIO_WriteBit(SSD1306_DC_Port, SSD1306_DC_Pin, Bit_RESET)

#if (SSD1306_CSPinUsed)
  #define SSD1306_CS_HIGH()     GPIO_WriteBit(SSD1306_CS_Port, SSD1306_CS_Pin, Bit_SET)
  #define SSD1306_CS_LOW()      GPIO_WriteBit(SSD1306_CS_Port, SSD1306_CS_Pin, Bit_RESET)
#else
  #define SSD1306_CS_HIGH()     ;
  #define SSD1306_CS_LOW()      ;
#endif


// вЂ“Р°Р·РјРµСЂС‹ РґРёСЃРїР»Рµв‚¬ РІ РїРёРєСЃРµР»в‚¬С…
uint8_t SSD1306_Height;
uint8_t SSD1306_Width;


//==============================================================================
// С•СЂРѕС†РµРґСѓСЂР° РїРµСЂРµРґР°Р„С‚ РєРѕРјР°РЅРґСѓ СЃ Р°СЂРіСѓРјРµРЅС‚Р°РјРё РІ ssd1306
//==============================================================================
void SSD1306_SendCommand(uint8_t Cmd, uint8_t *pBuff, uint16_t BuffLen)
{
#if (SSD1306_IfMode == SSD1306_IfMode_I2C)
  uint8_t tmpBuff[2];
  tmpBuff[0] = 0x00;    // Control byte (Co = 0, D/A = 0)
  tmpBuff[1] = Cmd;     //  РѕРјР°РЅРґР°
  
  int8_t err = i2cm_Start(SSD1306_I2C_periph, SSD1306_I2C_addr, 0, SSD1306_I2C_timeout);
  if (!err)
  {
    i2cm_WriteBuff(SSD1306_I2C_periph, tmpBuff, 2, SSD1306_I2C_timeout);
    i2cm_WriteBuff(SSD1306_I2C_periph, pBuff, BuffLen, SSD1306_I2C_timeout);
  }
  i2cm_Stop(SSD1306_I2C_periph, SSD1306_I2C_timeout);
#elif (SSD1306_IfMode == SSD1306_IfMode_SPI_4w)       // С•Р°СЂР°РјРµС‚СЂС‹ СЂР°Р±РѕС‚С‹ РїРѕ SPI-4w
  SSD1306_DC_LOW();
  SSD1306_CS_LOW();
  SPI_send8b(SSD1306_SPI_periph, &Cmd, 1);
  SPI_send8b(SSD1306_SPI_periph, pBuff, BuffLen);
  SSD1306_CS_HIGH();
#else   
  // СњСЃС‚Р°Р»СЊРЅС‹Рµ РёРЅС‚РµСЂС„РµР№СЃС‹ СЂР°Р±РѕС‚С‹ СЃ ssd1306 РїРѕРєР° РЅРµ РїРѕРґРґРµСЂР¶РёРІР°СЋС‚СЃв‚¬
#endif
}
//==============================================================================


//==============================================================================
// С•СЂРѕС†РµРґСѓСЂР° РїРµСЂРµРґР°Р„С‚ РјР°СЃСЃРёРІ РґР°РЅРЅС‹С… РІ ssd1306
//==============================================================================
void SSD1306_SendData(uint8_t *pBuff, uint16_t BuffLen)
{
#if (SSD1306_IfMode == SSD1306_IfMode_I2C)
  uint8_t tmpBuff = 0x40;    // Control byte (Co = 0, D/A = 1)
  
  int8_t err = i2cm_Start(SSD1306_I2C_periph, SSD1306_I2C_addr, 0, SSD1306_I2C_timeout);
  if (!err)
  {
    i2cm_WriteBuff(SSD1306_I2C_periph, &tmpBuff, 1, SSD1306_I2C_timeout);
    i2cm_WriteBuff(SSD1306_I2C_periph, pBuff, BuffLen, SSD1306_I2C_timeout);
  }
  i2cm_Stop(SSD1306_I2C_periph, SSD1306_I2C_timeout);
#elif (SSD1306_IfMode == SSD1306_IfMode_SPI_4w)       // С•Р°СЂР°РјРµС‚СЂС‹ СЂР°Р±РѕС‚С‹ РїРѕ SPI-4w
  SSD1306_DC_HIGH();
  SSD1306_CS_LOW();
  SPI_send8b(SSD1306_SPI_periph, pBuff, BuffLen);
  SSD1306_CS_HIGH();
  SSD1306_DC_LOW();
#else  
  // СњСЃС‚Р°Р»СЊРЅС‹Рµ РёРЅС‚РµСЂС„РµР№СЃС‹ СЂР°Р±РѕС‚С‹ СЃ ssd1306 РїРѕРєР° РЅРµ РїРѕРґРґРµСЂР¶РёРІР°СЋС‚СЃв‚¬
#endif
}
//==============================================================================


//==============================================================================
// С•СЂРѕС†РµРґСѓСЂР° РїРµСЂРµРґР°Р„С‚ РІ РґРёСЃРїР»РµР№ Р±СѓС„РµСЂ РєР°РґСЂР° РёР· РјР°СЃСЃРёРІР° pBuff
//==============================================================================
void SSD1306_DisplayFullUpdate(uint8_t *pBuff, uint16_t BuffLen)
{
  SSD1306_SetColumns(0, SSD1306_Width - 1);
  SSD1306_SetPages(0, (SSD1306_Height >> 3) - 1);
  SSD1306_SendData(pBuff, BuffLen);
}
//==============================================================================


//==============================================================================
// С•СЂРѕС†РµРґСѓСЂР° СѓСЃС‚Р°РЅР°РІР»РёРІР°РµС‚ СЂРµР¶РёРј Р°РІС‚РѕСЃРґРІРёРіР° СѓРєР°Р·Р°С‚РµР»в‚¬ РІ Р±СѓС„РµСЂРµ РєР°РґСЂР° ssd1306
//==============================================================================
void SSD1306_SetMemAdressingMode(uint8_t Mode)
{
  if (Mode > 2)
    return;
  
  SSD1306_SendCommand(SSD1306_CMD_SetMemAdressingMode | Mode , 0, 0);
}
//==============================================================================


//==============================================================================
// С•СЂРѕС†РµРґСѓСЂР° СѓСЃС‚Р°РЅР°РІР»РёРІР°РµС‚ РЅР°С‡Р°Р»СЊРЅС‹Р№ Рё РєРѕРЅРµС‡РЅС‹Р№ РёРЅРґРµРєСЃ РєРѕР»РѕРЅРєРё
// РґР»в‚¬ Р°РІС‚РѕСЃРјРµС‰РµРЅРёв‚¬ СѓРєР°Р·Р°С‚РµР»в‚¬ РІ РїР°Рјв‚¬С‚Рё РєР°РґСЂР° РїСЂРё С‡С‚РµРЅРёРё Р·Р°РїРёСЃРё.
//==============================================================================
void SSD1306_SetColumns(uint8_t Start, uint8_t End)
{
  Start &= 0x7F;
  End &= 0x7F;
  uint8_t Buff[] = {Start, End};
  SSD1306_SendCommand(SSD1306_CMD_SetColumnAddr, Buff, 2);
}
//==============================================================================


//==============================================================================
// С•СЂРѕС†РµРґСѓСЂР° СѓСЃС‚Р°РЅР°РІР»РёРІР°РµС‚ РЅР°С‡Р°Р»СЊРЅС‹Р№ Рё РєРѕРЅРµС‡РЅС‹Р№ РёРЅРґРµРєСЃ СЃС‚СЂР°РЅРёС†С‹
// РґР»в‚¬ Р°РІС‚РѕСЃРјРµС‰РµРЅРёв‚¬ СѓРєР°Р·Р°С‚РµР»в‚¬ РІ РїР°Рјв‚¬С‚Рё РєР°РґСЂР° РїСЂРё С‡С‚РµРЅРёРё Р·Р°РїРёСЃРё.
//==============================================================================
void SSD1306_SetPages(uint8_t Start, uint8_t End)
{
  Start &= 0x07;
  End &= 0x07;
  uint8_t Buff[] = {Start, End};
  SSD1306_SendCommand(SSD1306_CMD_SetPageAddr, Buff, 2);
}
//==============================================================================


//==============================================================================
// С•СЂРѕС†РµРґСѓСЂР° СѓСЃС‚Р°РЅР°РІР»РёРІР°РµС‚ СЃС‚СЂР°РЅРёС†Сѓ РґР»в‚¬ СЂРµР¶РёРјР° СЃС‚СЂР°РЅРёС‡РЅРѕР№ Р°РґСЂРµСЃСЃР°С†РёРёРё, РєРѕРіРґР°
// СЃРґРІРёРі СѓРєР°Р·Р°С‚РµР»в‚¬ РІ РїР°Рјв‚¬С‚Рё РґРµР»Р°РµС‚СЃв‚¬ С‚РѕР»СЊРєРѕ РїРѕ РіРѕСЂРёР·РѕРЅС‚Р°Р»Рё (SSD1306_Adressing_Page).
//==============================================================================
void SSD1306_PageAddrMode_SetPage(uint8_t Page)
{
  Page &= 0x07;
  SSD1306_SendCommand(SSD1306_CMD_PageAddrMode_SetPage | Page, 0, 0);
}
//==============================================================================


//==============================================================================
// С•СЂРѕС†РµРґСѓСЂР° СѓСЃС‚Р°РЅР°РІР»РёРІР°РµС‚ С” СЃС‚СЂРѕРєРё, РїРѕ РєРѕС‚РѕСЂРѕР№ СѓРєР°Р·Р°С‚РµР»СЊ РІ Р±СѓС„РµСЂРµ РєР°РґСЂР° Р±СѓРґРµС‚ РїРµСЂРµРјРµС‰Р°С‚СЊСЃв‚¬
// вЂњРѕР»СЊРєРѕ РґР»в‚¬ СЂРµР¶РёРјР° Р°РІС‚РѕСЃРґРІРёРіР° СѓРєР°Р·Р°С‚РµР»в‚¬ (SSD1306_Adressing_Page)
//==============================================================================
void SSD1306_PageAddrMode_StartColumn(uint8_t Start)
{
  Start &= 0x7F;
  SSD1306_SendCommand(SSD1306_CMD_PageAddrMode_StartColumnLo | (Start & 0x07), 0, 0);
  SSD1306_SendCommand(SSD1306_CMD_PageAddrMode_StartColumnHi | (Start >> 4), 0, 0);
}
//==============================================================================


//==============================================================================
// Set display RAM display start line register from 0-63
//==============================================================================
void SSD1306_SetDisplayStartLine(uint8_t Line)
{
  Line &= 0x3F;
  SSD1306_SendCommand(SSD1306_CMD_SetDisplayStartLine | Line, 0, 0);
}
//==============================================================================


//==============================================================================
// Value=0: column address 0 is mapped to SEG0 (RESET)
// Value=1: column address 127 is mapped to SEG0 
//==============================================================================
void SSD1306_SetSegmentRemap(uint8_t Value)
{
  Value = Value ? 1 : 0;
  SSD1306_SendCommand(SSD1306_CMD_SetSegmentRemap | Value, 0, 0);
}
//==============================================================================


//==============================================================================
void SSD1306_SetMultiplexRatio(uint8_t Mux)
{
  Mux--;
  Mux &= 0x3F;
  SSD1306_SendCommand(SSD1306_CMD_SetMultiplexRatio, &Mux, 1);
}
//==============================================================================


//==============================================================================
// вЂ”РјРµС‰РµРЅРёРµ РїРѕ РІРµСЂС‚РёРєР°Р»Рё РѕР±Р»Р°СЃС‚Рё РѕС‚РѕР±СЂР°Р¶РµРЅРёв‚¬ РѕС‚РЅРѕСЃРёС‚РµР»СЊРЅРѕ РїР°Рјв‚¬С‚Рё РєР°РґСЂР°
//==============================================================================
void SSD1306_SetDisplayOffset(uint8_t Offset)
{
  SSD1306_SendCommand(SSD1306_CMD_SetDisplayOffset, &Offset, 1);
}
//==============================================================================


//==============================================================================
void SSD1306_SetDisplayClockDivider(uint8_t DCLKdiv, uint8_t Fosc)
{
  DCLKdiv--;
  DCLKdiv &= 0x0F;
  DCLKdiv |= ((Fosc & 0x0F) << 4);
  SSD1306_SendCommand(SSD1306_CMD_SetDisplayClockDivider, &DCLKdiv, 1);
}
//==============================================================================


//==============================================================================
void SSD1306_ChargePumpSetting(uint8_t Value)
{
  Value = Value ? 0x14 : 0x10;
  SSD1306_SendCommand(SSD1306_CMD_ChargePumpSetting, &Value, 1);
}
//==============================================================================


//==============================================================================
// РЊР°РїСЂР°РІР»РµРЅРёРµ СЃРєР°РЅРёСЂРѕРІР°РЅРёв‚¬
// Value=0: normal mode (RESET) Scan from COM0 to COM[N Р¦1]
// Value=1: remapped mode. Scan from COM[N-1] to COM0
// Where N is the Multiplex ratio. 
//==============================================================================
void SSD1306_SetCOMoutScanDirection(uint8_t Value)
{
  Value = Value ? 0x08 : 0x00;
  SSD1306_SendCommand(SSD1306_CMD_SetCOMoutScanDirection | Value, 0, 0);
}
//==============================================================================


//==============================================================================
// AltCOMpinConfig=0: Sequential COM pin configuration
// AltCOMpinConfig=1(RESET): Alternative COM pinconfiguration
// LeftRightRemap=0(RESET): Disable COM Left/Right remap
// LeftRightRemap=1: Enable COM Left/Right remap 
//==============================================================================
void SSD1306_SetCOMPinsConfig(uint8_t AltCOMpinConfig, uint8_t LeftRightRemap)
{
  uint8_t tmpValue = (1 << 1);
  if (AltCOMpinConfig)
    tmpValue |= (1 << 4);
  if (LeftRightRemap)
    tmpValue |= (1 << 5);
  SSD1306_SendCommand(SSD1306_CMD_SetCOMPinsConfig, &tmpValue, 1);
}
//==============================================================================


//==============================================================================
void SSD1306_SetPrechargePeriod(uint8_t Phase1period, uint8_t Phase2period)
{
  Phase1period &= 0x0F;
  Phase1period &= 0x0F;
  if (!Phase1period)
    Phase1period = 2;
  if (!Phase2period)
    Phase2period = 2;
  Phase1period |= (Phase2period << 4);
  SSD1306_SendCommand(SSD1306_CMD_SetPrechargePeriod, &Phase1period, 1);
}
//==============================================================================


//==============================================================================
void SSD1306_SetVCOMHDeselectLevel(uint8_t Code)
{
  Code &= 0x70;
  SSD1306_SendCommand(SSD1306_CMD_SetVCOMHDeselectLevel, &Code, 1);
}
//==============================================================================


//==============================================================================
// С•СЂРѕС†РµРґСѓСЂР° РѕС‚РєР»СЋС‡Р°РµС‚ СЃРєСЂРѕР»Р» (СЃСЂРµРґСЃС‚РІР°РјРё РєРѕРЅС‚СЂРѕР»Р»РµСЂР° РґРёСЃРїР»Рµв‚¬
//==============================================================================
void SSD1306_DeactivateScroll(void)
{
  SSD1306_SendCommand(SSD1306_CMD_DeactivateScroll, 0, 0);
}
//==============================================================================


//==============================================================================
// С•СЂРѕС†РµРґСѓСЂР° РїРµСЂРµРІРѕРґРёС‚ РґРёСЃРїР»РµР№ РІ СЂРµР¶РёРј СЃРЅР°
//==============================================================================
void SSD1306_Sleep(void)
{
  SSD1306_SendCommand(SSD1306_CMD_Sleep, 0, 0);
}
//==============================================================================


//==============================================================================
// С•СЂРѕС†РµРґСѓСЂР° РІС‹РІРѕРґРёС‚ РґРёСЃРїР»РµР№ РёР· СЂРµР¶РёРјР° СЃРЅР°
//==============================================================================
void SSD1306_Wake(void)
{
  SSD1306_SendCommand(SSD1306_CMD_Wake, 0, 0);
}
//==============================================================================


//==============================================================================
// С•СЂРѕС†РµРґСѓСЂР° РІРєР»СЋС‡Р°РµС‚ РІСЃРµ РїРёРєСЃРµР»Рё РґРёСЃРїР»Рµв‚¬ (вЂњРµСЃС‚ РёРЅРґРёРєР°С‚РѕСЂР°)
//==============================================================================
void SSD1306_AllPixOn(void)
{
  SSD1306_SendCommand(SSD1306_CMD_AllPixOn, 0, 0);
}
//==============================================================================


//==============================================================================
// С•СЂРѕС†РµРґСѓСЂР° РѕС‚РєР»СЋС‡Р°РµС‚ С‚РµСЃС‚ РґРёСЃРїР»Рµв‚¬ Рё РІС‹РІРѕРґРёС‚ РЅР° РЅРµРіРѕ РєР°СЂС‚РёРЅРєСѓ РёР· Р±СѓС„РµСЂР° РєР°РґСЂР° РІ ssd1306
//==============================================================================
void SSD1306_AllPixRAM(void)
{
  SSD1306_SendCommand(SSD1306_CMD_AllPixRAM, 0, 0);
}
//==============================================================================


//==============================================================================
// С•СЂРѕС†РµРґСѓСЂР° РІРєР»СЋС‡Р°РµС‚ РёРЅРІРµСЂСЃРёСЋ РґРёСЃРїР»Рµв‚¬
//==============================================================================
void SSD1306_SetInverseOn(void)
{
  SSD1306_SendCommand(SSD1306_CMD_SetInverseOn, 0, 0);
}
//==============================================================================


//==============================================================================
// С•СЂРѕС†РµРґСѓСЂР° РѕС‚РєР»СЋС‡Р°РµС‚ РёРЅРІРµСЂСЃРёСЋ РґРёСЃРїР»Рµв‚¬
//==============================================================================
void SSD1306_SetInverseOff(void)
{
  SSD1306_SendCommand(SSD1306_CMD_SetInverseOff, 0, 0);
}
//==============================================================================


//==============================================================================
// С•СЂРѕС†РµРґСѓСЂР° СѓСЃС‚Р°РЅР°РІР»РёРІР°РµС‚ РїР°СЂР°РјРµС‚СЂ РєРѕРЅС‚СЂР°СЃС‚РЅРѕСЃС‚Рё (0-255)
//==============================================================================
void SSD1306_SetContrast(uint8_t Value)
{
  SSD1306_SendCommand(SSD1306_CMD_SetContrast, &Value, 1);
}
//==============================================================================


//==============================================================================
// С•СЂРѕС†РµРґСѓСЂР° РЅР°СЃС‚СЂРѕР№РєРё РЅРѕР¶РµРє РјРёРєСЂРѕРєРѕРЅС‚СЂРѕР»Р»РµСЂР° РґР»в‚¬ РѕР±РјРµРЅР° СЃ РґРёСЃРїР»РµРµРј
//==============================================================================
void SSD1306_GPIO_init(void)
{
  GPIO_InitTypeDef GPIO_InitStruct;
  GPIO_InitStruct.GPIO_Speed = GPIO_Speed_50MHz;
  GPIO_InitStruct.GPIO_Mode = GPIO_Mode_Out_PP;
  
#if (SSD1306_ResetPinUsed)      // В¬РєР»СЋС‡РµРЅРѕ СѓРїСЂР°РІР»РµРЅРёРµ РЅРѕР¶РєРѕР№ reset ssd1306
  gpio_PortClockStart(SSD1306_Reset_Port);
  GPIO_InitStruct.GPIO_Pin = SSD1306_Reset_Pin;
  GPIO_Init(SSD1306_Reset_Port, &GPIO_InitStruct);
#endif
  
#if (SSD1306_CSPinUsed)
  gpio_PortClockStart(SSD1306_CS_Port);
  GPIO_InitStruct.GPIO_Pin = SSD1306_CS_Pin;
  GPIO_Init(SSD1306_CS_Port, &GPIO_InitStruct);
#endif
  
#if (SSD1306_IfMode == SSD1306_IfMode_SPI_4w)       // вЂ“Р°Р±РѕС‚Р°РµРј РїРѕ SPI-4w
  gpio_PortClockStart(SSD1306_DC_Port);
  GPIO_InitStruct.GPIO_Pin = SSD1306_DC_Pin;
  GPIO_Init(SSD1306_DC_Port, &GPIO_InitStruct);
#endif
}
//==============================================================================


//==============================================================================
// С•СЂРѕС†РµРґСѓСЂР° РёРЅРёС†РёР°Р»РёР·Р°С†РёРё РґРёСЃРїР»Рµв‚¬ РЅР° РєРѕРЅС‚СЂРѕР»Р»РµСЂРµ ssd1306
//==============================================================================
void SSD1306_Init(uint8_t Width, uint8_t Height)
{
  SSD1306_Width = Width;
  SSD1306_Height = Height;
  
  SSD1306_GPIO_init();
  
  // В»РЅРёС†РёР°Р»РёР·Р°С†Рёв‚¬ РёРЅС‚РµСЂС„РµР№СЃР°
#if (SSD1306_IfMode == SSD1306_IfMode_I2C)      // I2C
  i2cm_init(SSD1306_I2C_periph, SSD1306_I2C_clock);
#elif (SSD1306_IfMode == SSD1306_IfMode_SPI_4w)       // С•Р°СЂР°РјРµС‚СЂС‹ СЂР°Р±РѕС‚С‹ РїРѕ SPI-4w
  spim_init(SSD1306_SPI_periph, 8);
#else 
  // СњСЃС‚Р°Р»СЊРЅС‹Рµ РёРЅС‚РµСЂС„РµР№СЃС‹ СЂР°Р±РѕС‚С‹ СЃ ssd1306 РїРѕРєР° РЅРµ РїРѕРґРґРµСЂР¶РёРІР°СЋС‚СЃв‚¬
#endif

  // вЂ”Р±СЂРѕСЃ РєРѕРЅС‚СЂРѕР»Р»РµСЂР° РґРёСЃРїР»Рµв‚¬ ssd1306 РЅРѕР¶РєРѕР№ Reset
#if (SSD1306_ResetPinUsed)      // В¬РєР»СЋС‡РµРЅРѕ СѓРїСЂР°РІР»РµРЅРёРµ РЅРѕР¶РєРѕР№ reset ssd1306
  SSD1306_RESET_HIGH();
  Delay_ms(2);
  SSD1306_RESET_LOW();  // вЂ“РѕРЅв‚¬РµРј РЅРѕР¶РєСѓ reset РІ 0 РЅР° 10 РјСЃ
  Delay_ms(15);
  SSD1306_RESET_HIGH();
#endif
  
  // РЋР»Р„Рј РєРѕРјР°РЅРґС‹ РёРЅРёС†РёР°Р»РёР·Р°С†РёРё ssd1306
  SSD1306_Sleep();
  SSD1306_SetDisplayClockDivider(1, 8);
  SSD1306_SetMultiplexRatio(SSD1306_Height);
  SSD1306_SetDisplayOffset(0);
  SSD1306_SetDisplayStartLine(0);
  SSD1306_ChargePumpSetting(1);
  SSD1306_SetMemAdressingMode(SSD1306_Adressing_Horizontal);
  SSD1306_SetSegmentRemap(0);           // *РјРµРЅв‚¬РµС‚ РЅР°РїСЂР°РІР»РµРЅРёРµ Р·Р°РїРѕР»РЅРµРЅРёРµ РјР°С‚СЂРёС†С‹ РёР· Р±СѓС„РµСЂР° РєР°РґСЂР° (РІРµСЂС‚РёРєР°Р»СЊ/РіРѕСЂРёР·РѕРЅС‚Р°Р»СЊ)
  SSD1306_SetCOMoutScanDirection(0);    // *РїРµСЂРµРІРѕСЂР°С‡РёРІР°РµС‚ РѕС‚РѕСЂР±СЂР°Р¶РµРЅРёРµ РЅР° РјР°С‚СЂРёС†Рµ (С‚РѕР»СЊРєРѕ РїРѕ РІРµСЂС‚РёРєР°Р»Рё)
  
  if ((SSD1306_Width == 128) && (SSD1306_Height == 32))
    SSD1306_SetCOMPinsConfig(0, 0);
  else  if ((SSD1306_Width == 128) && (SSD1306_Height == 64))
    SSD1306_SetCOMPinsConfig(1, 0);
  else  if ((SSD1306_Width == 96) && (SSD1306_Height == 16))
    SSD1306_SetCOMPinsConfig(0, 0);
  
  SSD1306_SetContrast(127);
  SSD1306_SetPrechargePeriod(2, 2);
  SSD1306_SetVCOMHDeselectLevel(0x40);
  SSD1306_AllPixRAM();
  SSD1306_SetInverseOff();
  SSD1306_DeactivateScroll();
  SSD1306_Wake();
}
//==============================================================================
